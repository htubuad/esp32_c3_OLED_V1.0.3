## sdkconfig.defaults
```kconfig
CONFIG_IDF_TARGET="esp32c3"
CONFIG_ESPTOOLPY_FLASHMODE_DIO=y
CONFIG_ESPTOOLPY_FLASHFREQ_40M=y
CONFIG_ESPTOOLPY_FLASHSIZE_4MB=y
CONFIG_ESP_WIFI_ENABLE_WPA3_SAE=n
CONFIG_ESP_WIFI_ENABLE_WPA3_OWE_STA=n
CONFIG_ESP_WIFI_11AX_SUPPORT=n
CONFIG_ESP_WIFI_STA_DISCONNECTED_PM=y
CONFIG_LWIP_NUM_NETIF_CLIENT_DATA=1
CONFIG_LWIP_IGMP=y
CONFIG_LWIP_TCP_SND_BUF_DEFAULT=8192
CONFIG_LWIP_TCP_WND_DEFAULT=8192
CONFIG_LWIP_TCP_RTO_TIME=800
CONFIG_LWIP_TCP_MAXRTX=8
```
